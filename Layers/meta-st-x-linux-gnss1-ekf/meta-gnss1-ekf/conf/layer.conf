## Layers/meta-st-x-linux-gnss1-ekf/meta-gnss1-ekf/conf/layer.conf
```bitbake
#we have a conf and classes directory, add to BBPATH

BBPATH .= ":${LAYERDIR}"
LICENSE = "Closed"

#we have recipes -* directories, add to BBFILES

BBFILES += "${LAYERDIR}/recipes-*/*/*.bb \
	   ${LAYERDIR}/recipes-*/*/*.bbappend"



BBFILE_COLLECTIONS += "gnss1-ekf"
BBFILE_PATTERN_gnss1-ekf = "^${LAYERDIR}/"
BBFILE_PRIORITY_gnss1-ekf = "7"


LAYERDEPENDS_gnss1-ekf = "core"
LAYERSERIES_COMPAT_gnss1-ekf= "mickledore" 
```

## Layers/meta-st-x-linux-gnss1-rtklib/meta-gnss1-rtklib/conf/layer.conf
```bitbake
#we have a conf and classes directory, add to BBPATH

BBPATH .= ":${LAYERDIR}"


#we have recipes -* directories, add to BBFILES

BBFILES += "${LAYERDIR}/recipes-*/*/*.bb \
	   ${LAYERDIR}/recipes-*/*/*.bbappend"



BBFILE_COLLECTIONS += "gnss1-rtklib"
BBFILE_PATTERN_gnss1-rtklib = "^${LAYERDIR}/"
BBFILE_PRIORITY_gnss1-rtklib = "7"


LAYERDEPENDS_gnss1-rtklib = "core"
LAYERSERIES_COMPAT_gnss1-rtklib = "kirkstone" 
```

## Layers/meta-st-x-linux-gnss1/meta-gnss1/conf/layer.conf
```bitbake
# We have a conf and classes directory, add to BBPATH
BBPATH .= ":${LAYERDIR}"

# We have recipes-* directories, add to BBFILES
BBFILES += "${LAYERDIR}/recipes-*/*/*.bb \
            ${LAYERDIR}/recipes-*/*/*.bbappend"

BBFILE_COLLECTIONS += "meta-gnss1"
BBFILE_PATTERN_meta-gnss1 = "^${LAYERDIR}/"
BBFILE_PRIORITY_meta-gnss1 = "7"

LAYERDEPENDS_meta-gnss1 = "core"
LAYERSERIES_COMPAT_meta-gnss1 = "kirkstone"
```
